## app/build_1/Kconfig/Kconfig.modules
```kconfig
menu "ncs-example-application (C:/Users/timrb/workspace/ncs-example-application)"
osource "C:/Users/timrb/workspace/ncs-example-application/Kconfig"
config ZEPHYR_NCS_EXAMPLE_APPLICATION_MODULE
	bool
	default y
endmenu
menu "nrf (C:/Users/timrb/workspace/nrf)"
osource "C:/Users/timrb/workspace/nrf/Kconfig.nrf"
config ZEPHYR_NRF_MODULE
	bool
	default y
endmenu
menu "mcuboot (C:/Users/timrb/workspace/bootloader/mcuboot)"
osource "$(ZEPHYR_MCUBOOT_KCONFIG)"
config ZEPHYR_MCUBOOT_MODULE
	bool
	default y
endmenu
menu "mbedtls (C:/Users/timrb/workspace/modules/crypto/mbedtls)"
osource "$(ZEPHYR_MBEDTLS_KCONFIG)"
config ZEPHYR_MBEDTLS_MODULE
	bool
	default y
endmenu
menu "oberon-psa-crypto (C:/Users/timrb/workspace/modules/crypto/oberon-psa-crypto)"
osource "C:/Users/timrb/workspace/modules/crypto/oberon-psa-crypto/Kconfig.oberon_psa_crypto"
config ZEPHYR_OBERON_PSA_CRYPTO_MODULE
	bool
	default y
endmenu
menu "trusted-firmware-m (C:/Users/timrb/workspace/modules/tee/tf-m/trusted-firmware-m)"
osource "$(ZEPHYR_TRUSTED_FIRMWARE_M_KCONFIG)"
config ZEPHYR_TRUSTED_FIRMWARE_M_MODULE
	bool
	default y
endmenu
config ZEPHYR_PSA_ARCH_TESTS_MODULE
	bool
	default y
config ZEPHYR_SOC_HWMV1_MODULE
	bool
	default y
menu "cjson (C:/Users/timrb/workspace/modules/lib/cjson)"
osource "$(ZEPHYR_CJSON_KCONFIG)"
config ZEPHYR_CJSON_MODULE
	bool
	default y
endmenu
menu "azure-sdk-for-c (C:/Users/timrb/workspace/modules/lib/azure-sdk-for-c)"
osource "$(ZEPHYR_AZURE_SDK_FOR_C_KCONFIG)"
config ZEPHYR_AZURE_SDK_FOR_C_MODULE
	bool
	default y
endmenu
menu "cirrus-logic (C:/Users/timrb/workspace/modules/hal/cirrus-logic)"
osource "C:/Users/timrb/workspace/modules/hal/cirrus-logic/Kconfig"
config ZEPHYR_CIRRUS_LOGIC_MODULE
	bool
	default y
endmenu
menu "openthread (C:/Users/timrb/workspace/modules/lib/openthread)"
osource "$(ZEPHYR_OPENTHREAD_KCONFIG)"
config ZEPHYR_OPENTHREAD_MODULE
	bool
	default y
endmenu
menu "suit-generator (C:/Users/timrb/workspace/modules/lib/suit-generator)"
osource "C:/Users/timrb/workspace/modules/lib/suit-generator/ncs/Kconfig"
config ZEPHYR_SUIT_GENERATOR_MODULE
	bool
	default y
endmenu
menu "suit-processor (C:/Users/timrb/workspace/modules/lib/suit-processor)"
osource "C:/Users/timrb/workspace/modules/lib/suit-processor/Kconfig"
config ZEPHYR_SUIT_PROCESSOR_MODULE
	bool
	default y
endmenu
menu "memfault-firmware-sdk (C:/Users/timrb/workspace/modules/lib/memfault-firmware-sdk)"
osource "C:/Users/timrb/workspace/modules/lib/memfault-firmware-sdk/ports/zephyr/Kconfig"
config ZEPHYR_MEMFAULT_FIRMWARE_SDK_MODULE
	bool
	default y
endmenu
menu "coremark (C:/Users/timrb/workspace/modules/benchmark/coremark)"
osource "$(ZEPHYR_COREMARK_KCONFIG)"
config ZEPHYR_COREMARK_MODULE
	bool
	default y
endmenu
menu "canopennode (C:/Users/timrb/workspace/modules/lib/canopennode)"
osource "$(ZEPHYR_CANOPENNODE_KCONFIG)"
config ZEPHYR_CANOPENNODE_MODULE
	bool
	default y
endmenu
menu "chre (C:/Users/timrb/workspace/modules/lib/chre)"
osource "C:/Users/timrb/workspace/modules/lib/chre/platform/zephyr/Kconfig"
config ZEPHYR_CHRE_MODULE
	bool
	default y
endmenu
menu "lz4 (C:/Users/timrb/workspace/modules/lib/lz4)"
osource "$(ZEPHYR_LZ4_KCONFIG)"
config ZEPHYR_LZ4_MODULE
	bool
	default y
endmenu
menu "nanopb (C:/Users/timrb/workspace/modules/lib/nanopb)"
osource "$(ZEPHYR_NANOPB_KCONFIG)"
config ZEPHYR_NANOPB_MODULE
	bool
	default y
endmenu
config ZEPHYR_TF_M_TESTS_MODULE
	bool
	default y
menu "zscilib (C:/Users/timrb/workspace/modules/lib/zscilib)"
osource "C:/Users/timrb/workspace/modules/lib/zscilib/Kconfig.zscilib"
config ZEPHYR_ZSCILIB_MODULE
	bool
	default y
endmenu
menu "cmsis (C:/Users/timrb/workspace/modules/hal/cmsis)"
osource "$(ZEPHYR_CMSIS_KCONFIG)"
config ZEPHYR_CMSIS_MODULE
	bool
	default y
endmenu
menu "cmsis-dsp (C:/Users/timrb/workspace/modules/lib/cmsis-dsp)"
osource "$(ZEPHYR_CMSIS_DSP_KCONFIG)"
config ZEPHYR_CMSIS_DSP_MODULE
	bool
	default y
endmenu
menu "cmsis-nn (C:/Users/timrb/workspace/modules/lib/cmsis-nn)"
osource "$(ZEPHYR_CMSIS_NN_KCONFIG)"
config ZEPHYR_CMSIS_NN_MODULE
	bool
	default y
endmenu
menu "fatfs (C:/Users/timrb/workspace/modules/fs/fatfs)"
osource "$(ZEPHYR_FATFS_KCONFIG)"
config ZEPHYR_FATFS_MODULE
	bool
	default y
endmenu
menu "hal_nordic (C:/Users/timrb/workspace/modules/hal/nordic)"
osource "$(ZEPHYR_HAL_NORDIC_KCONFIG)"
config ZEPHYR_HAL_NORDIC_MODULE
	bool
	default y

config ZEPHYR_HAL_NORDIC_MODULE_BLOBS
	bool
endmenu
menu "hal_st (C:/Users/timrb/workspace/modules/hal/st)"
osource "$(ZEPHYR_HAL_ST_KCONFIG)"
config ZEPHYR_HAL_ST_MODULE
	bool
	default y
endmenu
config ZEPHYR_HAL_WURTHELEKTRONIK_MODULE
	bool
	default y
menu "hostap (C:/Users/timrb/workspace/modules/lib/hostap)"
osource "$(ZEPHYR_HOSTAP_KCONFIG)"
config ZEPHYR_HOSTAP_MODULE
	bool
	default y
endmenu
config ZEPHYR_LIBMETAL_MODULE
	bool
	default y
menu "liblc3 (C:/Users/timrb/workspace/modules/lib/liblc3)"
osource "$(ZEPHYR_LIBLC3_KCONFIG)"
config ZEPHYR_LIBLC3_MODULE
	bool
	default y
endmenu
menu "littlefs (C:/Users/timrb/workspace/modules/fs/littlefs)"
osource "$(ZEPHYR_LITTLEFS_KCONFIG)"
config ZEPHYR_LITTLEFS_MODULE
	bool
	default y
endmenu
menu "loramac-node (C:/Users/timrb/workspace/modules/lib/loramac-node)"
osource "$(ZEPHYR_LORAMAC_NODE_KCONFIG)"
config ZEPHYR_LORAMAC_NODE_MODULE
	bool
	default y
endmenu
menu "lvgl (C:/Users/timrb/workspace/modules/lib/gui/lvgl)"
osource "C:/Users/timrb/workspace/modules/lib/gui/lvgl/Kconfig"
config ZEPHYR_LVGL_MODULE
	bool
	default y
endmenu
config ZEPHYR_MIPI_SYS_T_MODULE
	bool
	default y
menu "nrf_wifi (C:/Users/timrb/workspace/modules/lib/nrf_wifi)"
osource "$(ZEPHYR_NRF_WIFI_KCONFIG)"
config ZEPHYR_NRF_WIFI_MODULE
	bool
	default y

config ZEPHYR_NRF_WIFI_MODULE_BLOBS
	bool
endmenu
config ZEPHYR_OPEN_AMP_MODULE
	bool
	default y
menu "picolibc (C:/Users/timrb/workspace/modules/lib/picolibc)"
osource "C:/Users/timrb/workspace/modules/lib/picolibc/zephyr/Kconfig"
config ZEPHYR_PICOLIBC_MODULE
	bool
	default y
endmenu
menu "segger (C:/Users/timrb/workspace/modules/debug/segger)"
osource "$(ZEPHYR_SEGGER_KCONFIG)"
config ZEPHYR_SEGGER_MODULE
	bool
	default y
endmenu
config ZEPHYR_TINYCRYPT_MODULE
	bool
	default y
menu "uoscore-uedhoc (C:/Users/timrb/workspace/modules/lib/uoscore-uedhoc)"
osource "$(ZEPHYR_UOSCORE_UEDHOC_KCONFIG)"
config ZEPHYR_UOSCORE_UEDHOC_MODULE
	bool
	default y
endmenu
menu "zcbor (C:/Users/timrb/workspace/modules/lib/zcbor)"
osource "$(ZEPHYR_ZCBOR_KCONFIG)"
config ZEPHYR_ZCBOR_MODULE
	bool
	default y
endmenu
menu "nrfxlib (C:/Users/timrb/workspace/nrfxlib)"
osource "C:/Users/timrb/workspace/nrfxlib/Kconfig.nrfxlib"
config ZEPHYR_NRFXLIB_MODULE
	bool
	default y
endmenu
config ZEPHYR_NRF_HW_MODELS_MODULE
	bool
	default y
menu "connectedhomeip (C:/Users/timrb/workspace/modules/lib/matter)"
osource "C:/Users/timrb/workspace/modules/lib/matter/config/nrfconnect/chip-module/Kconfig"
config ZEPHYR_CONNECTEDHOMEIP_MODULE
	bool
	default y
endmenu
```

## app/build_1/Kconfig/Kconfig.shield.defconfig
```kconfig
osource "C:/Users/timrb/workspace/ncs-example-application/boards/shields/*/Kconfig.defconfig"
osource "C:/Users/timrb/workspace/ncs-example-application/boards/shields/*/Kconfig.defconfig"
osource "C:/Users/timrb/workspace/nrf/boards/shields/*/Kconfig.defconfig"
```

## app/build_1/Kconfig/boards/Kconfig.arduino_nano_33_ble
```kconfig
# Load board Kconfig descriptions.
osource "C:/Users/timrb/workspace/zephyr/boards/arduino/nano_33_ble/Kconfig.arduino_nano_33_ble"
```

## app/build_1/Kconfig/boards/Kconfig.sysbuild
```kconfig
# Load Sysbuild board Kconfig descriptions.
osource "C:/Users/timrb/workspace/zephyr/boards/arduino/nano_33_ble/Kconfig.sysbuild"
```

## app/build_1/app/Kconfig/Kconfig.shield
```kconfig
osource "C:/Users/timrb/workspace/ncs-example-application/boards/shields/*/Kconfig.shield"
osource "C:/Users/timrb/workspace/ncs-example-application/boards/shields/*/Kconfig.shield"
osource "C:/Users/timrb/workspace/nrf/boards/shields/*/Kconfig.shield"
```

## app/build_1/app/Kconfig/arch/Kconfig
```kconfig
# Load Zephyr Arch Kconfig descriptions.
osource "C:/Users/timrb/workspace/zephyr/arch/x86/Kconfig"
osource "C:/Users/timrb/workspace/zephyr/arch/xtensa/Kconfig"
osource "C:/Users/timrb/workspace/zephyr/arch/sparc/Kconfig"
osource "C:/Users/timrb/workspace/zephyr/arch/riscv/Kconfig"
osource "C:/Users/timrb/workspace/zephyr/arch/posix/Kconfig"
osource "C:/Users/timrb/workspace/zephyr/arch/nios2/Kconfig"
osource "C:/Users/timrb/workspace/zephyr/arch/mips/Kconfig"
osource "C:/Users/timrb/workspace/zephyr/arch/arm64/Kconfig"
osource "C:/Users/timrb/workspace/zephyr/arch/arm/Kconfig"
osource "C:/Users/timrb/workspace/zephyr/arch/arc/Kconfig"
```

## app/build_1/app/Kconfig/boards/Kconfig.defconfig
```kconfig
# Load Zephyr board defconfig descriptions.
osource "C:/Users/timrb/workspace/zephyr/boards/arduino/nano_33_ble/Kconfig.defconfig"
```

## lib/etl/Kconfig
```kconfig
menuconfig ETL
    bool "Etl"
    select ETL_LIB
	help
	  A C++ template library for embedded applications.

if ETL

config ETL_LIB
    bool "Support Embedded Template Library"
    depends on CPP

config APP_LINK_WITH_ETL
	bool "Link 'app' with ETL"
	default n
	depends on ETL
	help
	  Add ETL header files to the 'app' include path.
	  The user must create a file named etl_profile.h
	  that exists in the include path for the project.
	  Look at https://www.etlcpp.com/setup.html

config ETL_PROFILE
	string "ETL_PROFILE"
	default "PROFILE_GCC_GENERIC"
	help
	  allowed values:
	  PROFILE_GCC_GENERIC
	  PROFILE_CLANG_GENERIC
	  PROFILE_MSVC
	  PROFILE_ARMV6
	  PROFILE_ARMV5

endif
```
