## CMakeLists.txt
```
#-------------------------------------------------------------------------------
# Zephyr Example Application
#
# Copyright (c) 2021 Nordic Semiconductor ASA
# SPDX-License-Identifier: Apache-2.0

# /app level CMakeLists.txt
cmake_minimum_required(VERSION 3.20.0)

set(BOARD_RUNNER jlink)
set(BOARD arduino_nano_33_ble/nrf52840/sense)
set(DTC_OVERLAY_FILE ${CMAKE_SOURCE_DIR}/../boards/arm/arduino_nano_33_sense/nano33sense.overlay)
set(CMAKE_CXX_STANDARD 11)
set(CMAKE_CXX_STANDARD_REQUIRED ON)

find_package(Zephyr REQUIRED HINTS $ENV{ZEPHYR_BASE})

project(app LANGUAGES C CXX)

target_sources(app PRIVATE src/main.cpp )

target_include_directories(app PRIVATE ${CMAKE_CURRENT_SOURCE_DIR}/../lib/etl_setup)
zephyr_library_include_directories(${CMAKE_CURRENT_SOURCE_DIR}/../lib/etl_type)

#EOF /app level
```

## prj.conf
```kconfig
# Copyright (c) 2021 Nordic Semiconductor ASA
# SPDX-License-Identifier: Apache-2.0
#
# This file contains selected Kconfig options for the application.

CONFIG_SENSOR=y

# RTT logging
CONFIG_UART_CONSOLE=n
CONFIG_RTT_CONSOLE=y
CONFIG_USE_SEGGER_RTT=y

CONFIG_CPP=y
CONFIG_GLIBCXX_LIBCPP=y

# === NUS ===
CONFIG_BT=y
CONFIG_BT_PERIPHERAL=y
CONFIG_BT_ZEPHYR_NUS=y
CONFIG_BT_CENTRAL=y
# === NUS ===

# === to address an error with threaded code ===
CONFIG_STATIC_INIT_GNU=y

# to enable NUS
CONFIG_SERIAL=y
CONFIG_NRFX_UARTE0=n
CONFIG_UART_ASYNC_API=y
CONFIG_UART_CONSOLE=y 
CONFIG_UART_MCUMGR=y 

CONFIG_RING_BUFFER=y

##==================

CONFIG_CBPRINTF_FP_SUPPORT=y

CONFIG_STDOUT_CONSOLE=n

CONFIG_USE_SEGGER_RTT=y
CONFIG_PRINTK=y 
CONFIG_LOG=y 
CONFIG_LOG_BACKEND_RTT=y



# === to address an error with threaded code ===
CONFIG_STATIC_INIT_GNU=y



CONFIG_CLOCK_CONTROL_NRF_K32SRC_RC=y
```

## src/main.c
```c
/*
 * Copyright (c) 2021 Nordic Semiconductor ASA
 * SPDX-License-Identifier: Apache-2.0
 */

#include <zephyr/kernel.h>
#include <zephyr/drivers/sensor.h>
#include <zephyr/logging/log.h>

#include <app/drivers/blink.h>

#include <app_version.h>

LOG_MODULE_REGISTER(main, CONFIG_APP_LOG_LEVEL);

#define BLINK_PERIOD_MS_STEP 100U
#define BLINK_PERIOD_MS_MAX  1000U

#define LED4_NODE DT_ALIAS(led4)

int main(void)
{
	int ret;
	//unsigned int period_ms = BLINK_PERIOD_MS_MAX;
	const struct device *sensor; //, *blink;
	struct sensor_value last_val = { 0 }, val;

	printk("Zephyr Example Application %s\n", APP_VERSION_STRING);

	sensor = DEVICE_DT_GET(DT_NODELABEL(lsm9ds1));
	if (!device_is_ready(sensor)) {
		LOG_ERR("Sensor not ready");
		return 0;
	}

	/*
	blink = DEVICE_DT_GET(DT_NODELABEL(led4));
	if (!device_is_ready(blink)) {
		LOG_ERR("Blink LED not ready");
		return 0;
	}

	ret = blink_off(blink);
	if (ret < 0) {
		LOG_ERR("Could not turn off LED (%d)", ret);
		return 0;
	}

	printk("Use the sensor to change LED blinking period\n");
	*/
	while (1) {
		ret = sensor_sample_fetch(sensor);
		if (ret < 0) {
			LOG_ERR("Could not fetch sample (%d)", ret);
			return 0;
		}

		ret = sensor_channel_get(sensor, SENSOR_CHAN_PROX, &val);
		if (ret < 0) {
			LOG_ERR("Could not get sample (%d)", ret);
			return 0;
		}

		/*
		if ((last_val.val1 == 0) && (val.val1 == 1)) {
			if (period_ms == 0U) {
				period_ms = BLINK_PERIOD_MS_MAX;
			} else {
				period_ms -= BLINK_PERIOD_MS_STEP;
			}

			printk("Proximity detected, setting LED period to %u ms\n",
			       period_ms);
			blink_set_period_ms(blink, period_ms);
		}
		*/
	
		last_val = val;

		k_sleep(K_MSEC(100));
	}

	return 0;
}
```

## src/main.cpp
```c
/*
 * Copyright (c) 2021 Nordic Semiconductor ASA
 * SPDX-License-Identifier: Apache-2.0
 */

#include <zephyr/kernel.h>
#include <zephyr/drivers/sensor.h>
#include <zephyr/logging/log.h>

//extern "C"{
//}
#include <app/etl_type/pubsub_store.h>

#include <app_version.h>

LOG_MODULE_REGISTER(main, CONFIG_APP_LOG_LEVEL);

#define BLINK_PERIOD_MS_STEP 100U
#define BLINK_PERIOD_MS_MAX  1000U

#define LED4_NODE DT_ALIAS(led4)

int main(void)
{
	int ret;

	const struct device *sensor;
	struct sensor_value last_val = { 0 }, val;

	printk("--> Zephyr Example Application %s\n", APP_VERSION_STRING);

	sensor = DEVICE_DT_GET(DT_NODELABEL(lsm9ds1));
	if (!device_is_ready(sensor)) {
		LOG_ERR("Sensor not ready");
		return 0;
	}
	
	//etl::deque<int,5> tim;

	while (1) {
		ret = sensor_sample_fetch(sensor);
		if (ret < 0) {
			LOG_ERR("Could not fetch sample (%d)", ret);
			return 0;
		}

		ret = sensor_channel_get(sensor, SENSOR_CHAN_PROX, &val);
		if (ret < 0) {
			LOG_ERR("Could not get sample (%d)", ret);
			return 0;
		}
	
		last_val = val;

		k_sleep(K_MSEC(100));
	}

	return 0;
}
```
